## sources/meta-beaglebone/conf/bblayers.conf.sample
```bitbake
# POKY_BBLAYERS_CONF_VERSION is increased each time build/conf/bblayers.conf
# changes incompatibly
POKY_BBLAYERS_CONF_VERSION = "2"

BBPATH = "${TOPDIR}"
BBFILES ?= ""
BSPDIR := "${@os.path.abspath(os.path.dirname(d.getVar('FILE', True)) + '/../..')}"

BBLAYERS ?= " \
  ##OEROOT##/meta \
  ##OEROOT##/meta-poky \
  ##OEROOT##/meta-yocto-bsp \
  ##OEROOT##/../meta-openembedded/meta-oe \
  ##OEROOT##/../meta-openembedded/meta-networking \
  ##OEROOT##/../meta-openembedded/meta-python \
  ##OEROOT##/../meta-openembedded/meta-multimedia \
  ##OEROOT##/../meta-openembedded/meta-xfce \
  ##OEROOT##/../meta-openembedded/meta-gnome \
  ##OEROOT##/../meta-beaglebone \
  "
```

## sources/meta-beaglebone/conf/distro/bbb-x11.conf
```bitbake
require conf/distro/poky.conf

DISTRO = "bbb-x11"
DISTRO_NAME = "BeagleBone Release Distro"
DISTRO_VERSION = "dunfell"

DISTRO_FEATURES_append = " x11 systemd pam"

MAINTAINER = "Thai Kien Le (thaikien.kc@gmail.com)"

INHERIT_remove = "uninative"
```

## sources/meta-beaglebone/conf/layer.conf
```bitbake
# We have a conf and classes directory, append to BBPATH
BBPATH .= ":${LAYERDIR}"

# We have a recipes directory, add to BBFILES
BBFILES += "${LAYERDIR}/recipes*/*/*.bb ${LAYERDIR}/recipes*/*/*.bbappend"

BBFILE_COLLECTIONS += "meta-beaglebone"
BBFILE_PATTERN_meta-beaglebone := "^${LAYERDIR}/"
BBFILE_PRIORITY_meta-beaglebone = "1"

LAYERSERIES_COMPAT_meta-beaglebone = "zeus dunfell"
```

## sources/meta-beaglebone/conf/local.conf.sample
```bitbake
MACHINE ?= "beagleboneblack"
DISTRO ?= "bbb-x11"
PACKAGE_CLASSES ?= "package_deb"
EXTRA_IMAGE_FEATURES ?= "debug-tweaks"
USER_CLASSES ?= "buildstats image-mklibs image-prelink"
PATCHRESOLVE = "noop"
BB_DISKMON_DIRS ??= "\
    STOPTASKS,${TMPDIR},1G,100K \
    STOPTASKS,${DL_DIR},1G,100K \
    STOPTASKS,${SSTATE_DIR},1G,100K \
    STOPTASKS,/tmp,100M,100K \
    ABORT,${TMPDIR},100M,1K \
    ABORT,${DL_DIR},100M,1K \
    ABORT,${SSTATE_DIR},100M,1K \
    ABORT,/tmp,10M,1K"
CONF_VERSION = "1"
VIRTUAL-RUNTIME_init_manager = "systemd"
PACKAGECONFIG_append_pn-systemd = " resolved networkd"
DL_DIR ?= "${BSPDIR}/downloads/"
```

## sources/meta-beaglebone/conf/machine/beagleboneblack.conf
```bitbake
#@TYPE: Machine
#@NAME: BeagleBone Black machine
#@DESCRIPTION: BeagleBone Black Evaluation board config file

SOC_FAMILY = "am335x"
require conf/machine/include/tune-cortexa8.inc
require conf/machine/include/soc-family.inc

DEFAULTTUNE = "cortexa8hf-neon"

PREFERRED_PROVIDER_virtual/kernel = "linux-bbb"
PREFERRED_VERSION_linux-bbb = "5.4%"

SERIAL_CONSOLES = "115200;ttyO0"
KERNEL_IMAGETYPE = "zImage"
KBUILD_DEFCONFIG = "ti_sdk_am3x_release_defconfig"

PREFERRED_PROVIDER_virtual/bootloader ?= "u-boot-bbb"

KERNEL_IMAGETYPE = "zImage"
KERNEL_DEVICETREE = "am335x-boneblack.dtb"
KERNEL_EXTRA_ARGS += "LOADADDR=${UBOOT_ENTRYPOINT}"

SPL_BINARY = "MLO"
UBOOT_SUFFIX = "img"
UBOOT_MACHINE = "am335x_evm_defconfig"
UBOOT_ENTRYPOINT = "0x80008000"
UBOOT_LOADADDRESS = "0x80008000"

MACHINE_EXTRA_RRECOMMENDS = "kernel-modules kernel-devicetree"
IMAGE_INSTALL_append = " kernel-devicetree kernel-image-zimage"

MACHINE_ESSENTIAL_EXTRA_RRECOMMENDS += "\
    resize-helper \
"

IMAGE_FSTYPES += "bbb-gpt-image"
IMAGE_CLASSES += "bbb-gpt-image"
```
